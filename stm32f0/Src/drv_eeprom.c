/**
 ******************************************************************************
 * @file    drv_eeprom.c
 * @author  MEMS Application Team
 * @version V1.1
 * @date    10-August-2016
 * @brief   drv_eeprom source file
 ******************************************************************************
 */

/* Includes ------------------------------------------------------------------*/
#include "string.h"
#include "drv_eeprom.h"
#include "drv.h"

#define EDID_I2C_ADDR    0xA0
#define SEDID_SIZE       128
#define EEDID_SIZE       256

#define EEPROM_BYTES_PER_ROW  8

/* Private variables ---------------------------------------------------------*/
extern I2C_HandleTypeDef hi2c2;

static uint8_t IT6802_HDMI_EDID_TABLE[256] = {
#if 0  
  0x00,0xFF,0xFF,0xFF,0xFF,0xFF,0xFF,0x00,// address 0x00
  0x11,0x90,0x50,0x50,0x01,0x00,0x00,0x00,//
  0x08,0x13,0x01,0x03,0x80,0x34,0x20,0xA0,// address 0x10
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  0x00,0x00,0x00,0x00,0x00,0x00,0x00,0x69,//
#else
  0x00,0x00,0x00,0x00,0x00,0x00,0x00,0x00,// address 0x00
  0x02,0x02,0x02,0x02,0x02,0x02,0x02,0x02,//
  0x04,0x04,0x04,0x04,0x04,0x04,0x04,0x04,// address 0x10
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  0x00,0x00,0x00,0x00,0x00,0x00,0x00,0x69,//
#endif
};

/* Private function prototypes -----------------------------------------------*/

/**
  * @brief  The drv_eeprom init.
  */
void Drv_EEPROM_Init(void)
{

}

void Drv_EEPROM_Proc(void)
{

}

uint8_t drv_eeprom_read_edid(void)
{
  uint8_t row[EEPROM_BYTES_PER_ROW], pages;
  uint8_t i,ret,offset;

  pages = (sizeof(IT6802_HDMI_EDID_TABLE)>SEDID_SIZE?EEDID_SIZE:SEDID_SIZE)/EEPROM_BYTES_PER_ROW;
  for (i=0,offset=0;i<pages;i++,offset+=EEPROM_BYTES_PER_ROW)
  {
    ret = HAL_I2C_Mem_Read(&hi2c2, EDID_I2C_ADDR, offset, 1, row, EEPROM_BYTES_PER_ROW, 1000);
    if (ret == HAL_OK)
    {
      Drv_SERIAL_Log("row 0x%02X: 0x%02X 0x%02X 0x%02X 0x%02X 0x%02X 0x%02X 0x%02X 0x%02X", 
                      i*EEPROM_BYTES_PER_ROW,
                      row[0],row[1],row[2],row[3],row[4],row[5],row[6],row[7]);
    }
    else
    {
      Drv_SERIAL_Log("EDID Read error in row 0x%02X", i*EEPROM_BYTES_PER_ROW);
      break;
    }
  }
  
  return ret;
}

uint8_t drv_eeprom_write_edid(void)
{
  uint8_t row[EEPROM_BYTES_PER_ROW], pages;
  uint8_t i,ret,offset;
  
  pages = (sizeof(IT6802_HDMI_EDID_TABLE)>SEDID_SIZE?EEDID_SIZE:SEDID_SIZE)/EEPROM_BYTES_PER_ROW;
  for (i=0,offset=0;i<pages;i++,offset+=EEPROM_BYTES_PER_ROW)
  {
    ret = HAL_I2C_Mem_Write(&hi2c2, EDID_I2C_ADDR, 
                            offset, 1, &IT6802_HDMI_EDID_TABLE[offset], 
                            EEPROM_BYTES_PER_ROW, 1000);
    if (HAL_OK==ret)
    {
      ret = HAL_I2C_Mem_Read(&hi2c2, EDID_I2C_ADDR, 
                             offset, 1, row, 
                             EEPROM_BYTES_PER_ROW, 1000);
      if (HAL_OK==ret)
      {
        if (memcmp(row, &IT6802_HDMI_EDID_TABLE[offset], EEPROM_BYTES_PER_ROW))
        {
          Drv_SERIAL_Log("EDID Write check error in row 0x%02X", offset);          
          return HAL_ERROR;
        }
      }
      else
      {
        Drv_SERIAL_Log("EDID Write read error in row 0x%02X", offset);
        return HAL_ERROR;
      }
    }
    else
    {
      Drv_SERIAL_Log("EDID Write write error in row 0x%02X", offset);
      return HAL_ERROR;
    }
  }

  Drv_SERIAL_Log("EDID Write successful!");
  return HAL_OK;
}

